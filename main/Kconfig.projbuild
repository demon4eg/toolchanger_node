## main/Kconfig.projbuild
```kconfig
menu "micro-ROS APP settings"

    config MICRO_ROS_APP_STACK
        int "Stack the micro-ROS app (Bytes)"
        default 16000
        help
        Stack size in Bytes of the micro-ROS app

    config MICRO_ROS_APP_TASK_PRIO
        int "Priority of the micro-ROS app"
        default 5
        help
        Priority of micro-ros task higher value means higher priority
        
endmenu

menu "DS18B20 Configuration"

    config EXAMPLE_ONEWIRE_BUS_GPIO
        int "1-Wire bus GPIO number"
        range 0 48
        default 0
        help
            GPIO used by the 1-Wire bus.

    config EXAMPLE_ONEWIRE_MAX_DS18B20
        int "Maximum number of DS18B20 devices to enumerate"
        range 1 32
        default 2
        help
            Stop searching after this many DS18B20 devices are found.

    config EXAMPLE_ONEWIRE_ENABLE_INTERNAL_PULLUP
        bool "Enable internal pull-up resistor on bus GPIO"
        default y
        help
            Enable this when there is no external pull-up resistor on the
            1-Wire data line.

    choice EXAMPLE_ONEWIRE_BACKEND
        prompt "1-Wire backend"
        default EXAMPLE_ONEWIRE_BACKEND_RMT
        help
            Select which backend is used by onewire_bus.

        config EXAMPLE_ONEWIRE_BACKEND_RMT
            bool "RMT backend"

        config EXAMPLE_ONEWIRE_BACKEND_UART
            bool "UART backend"
    endchoice

    config EXAMPLE_ONEWIRE_UART_PORT_NUM
        int "UART port number (for UART backend)"
        range 0 2
        default 1
        depends on EXAMPLE_ONEWIRE_BACKEND_UART
        help
            UART port index passed to onewire_new_bus_uart().

endmenu

menu "INA3221 configuration"
    config EXAMPLE_SHUNT_RESISTOR_MILLI_OHM
        int "Shunt resistor value in milliohms"
        default 100

    config EXAMPLE_I2C_ADDR
        hex "I2C address of INA3221"
        default 0x40
        help
            I2C address of INA3221. The default is `INA3221_I2C_ADDR_GND`, or
            0x40. See available options in ina3221.h.

    choice EXAMPLE_MEASURING_MODE
        prompt "Select measuring mode"
        default EXAMPLE_MEASURING_MODE_TRIGGER
        config EXAMPLE_MEASURING_MODE_TRIGGER
            bool "Trigger measurements"
            help
                Measuring mode to use. See 8.3.1 Basic ADC Functions in the datasheet.
        config EXAMPLE_MEASURING_MODE_CONTINUOUS
            bool "Continuous  measurements"
            help
                Measuring mode to use. See 8.3.1 Basic ADC Functions in the datasheet.
    endchoice

    rsource "../Kconfig.i2c"
endmenu
```
